/* 
 * Humidor version 003
 *  This is the family/gift build.
 * 
 *  Adafruit Feather M0 Basic Proto [ Board: Adafruit Feather M0 ]
 *  Adafruit SHT40 Sensirion Temperature & Humidity Sensor
 *  Adafruit 128x64 OLED FeatherWing
 *  Adafruit RGB Smart NeoPixel
 */

// oled
#include <SPI.h>
#include <Wire.h>
#include <Adafruit_GFX.h>
#include <Adafruit_SH110X.h>

// sensor
#include "Adafruit_SHT4x.h"

// NeoPixel
#include "FastLED.h"

// OLED FeatherWing buttons map (board specific)
#define BUTTON_A_PIN  9
#define BUTTON_B_PIN  6
#define BUTTON_C_PIN  5

#define LED_PIN       10

struct readings {
  float maxValue;
  float minValue;
  float avgValue;
  float lastValue;
  long count;
};

/*
 ██████  ██       ██████  ██████   █████  ██      ███████ 
██       ██      ██    ██ ██   ██ ██   ██ ██      ██      
██   ███ ██      ██    ██ ██████  ███████ ██      ███████ 
██    ██ ██      ██    ██ ██   ██ ██   ██ ██           ██ 
 ██████  ███████  ██████  ██████  ██   ██ ███████ ███████ 
 */

Adafruit_SH1107 display = Adafruit_SH1107(64, 128, &Wire);
Adafruit_SHT4x sht4 = Adafruit_SHT4x();

struct readings temperatureReadings;
struct readings humidityReadings;

CRGB leds[1];

// cigar frame 1, 128x54px
const unsigned char cigar_1 [] PROGMEM = {
  0xff, 0xff, 0xff, 0xff, 0xff, 0xff, 0xff, 0xff, 0xff, 0xff, 0xff, 0xff, 0xff, 0xdf, 0x81, 0xff, 
  0xff, 0xff, 0xff, 0xff, 0xff, 0xff, 0xff, 0xff, 0xff, 0xff, 0xff, 0xff, 0xff, 0xe7, 0x00, 0xff, 
  0xff, 0xff, 0xff, 0xff, 0xff, 0xff, 0xff, 0xff, 0xff, 0xff, 0xff, 0xff, 0xff, 0xe6, 0x01, 0xff, 
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  0xff, 0xff, 0xff, 0xff, 0xff, 0xff, 0xff, 0xff, 0xff, 0xff, 0xff, 0xff, 0xff, 0xff, 0xff, 0xff
};
// cigar frame 2, 128x54px
const unsigned char cigar_2 [] PROGMEM = {
  0xff, 0xff, 0xff, 0xff, 0xff, 0xff, 0xff, 0xff, 0xff, 0xff, 0xff, 0xff, 0xff, 0xc2, 0x3f, 0x7f, 
  0xff, 0xff, 0xff, 0xff, 0xff, 0xff, 0xff, 0xff, 0xff, 0xff, 0xff, 0xff, 0xef, 0xc2, 0x3f, 0x7f, 
  0xff, 0xff, 0xff, 0xff, 0xff, 0xff, 0xff, 0xff, 0xff, 0xff, 0xff, 0xff, 0xfb, 0xe6, 0x7c, 0x7f, 
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  0xff, 0xff, 0xff, 0xff, 0xff, 0xff, 0xff, 0xff, 0xff, 0xff, 0xff, 0xff, 0xff, 0xff, 0xff, 0xff
};
// cigar frame 3, 128x54px
const unsigned char cigar_3 [] PROGMEM = {
  0xff, 0xff, 0xff, 0xff, 0xff, 0xff, 0xff, 0xff, 0xff, 0xff, 0xef, 0x47, 0xff, 0xff, 0xff, 0xff, 
  0xff, 0xff, 0xff, 0xff, 0xff, 0xff, 0xff, 0xff, 0xff, 0xff, 0xe0, 0x0f, 0xff, 0xff, 0xff, 0xff, 
  0xff, 0xff, 0xff, 0xff, 0xff, 0xff, 0xff, 0xff, 0xff, 0xff, 0xc0, 0xff, 0xff, 0xff, 0xff, 0xff, 
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  0xff, 0xff, 0xff, 0xff, 0xff, 0xff, 0xff, 0xff, 0xff, 0xff, 0xff, 0xff, 0xff, 0xff, 0xff, 0xff
};
// cigar frame 4, 128x54px
const unsigned char cigar_4 [] PROGMEM = {
  0xff, 0xff, 0xff, 0xff, 0xff, 0xff, 0xff, 0xff, 0xff, 0xfe, 0x07, 0xff, 0xff, 0xff, 0xff, 0xff, 
  0xff, 0xff, 0xff, 0xff, 0xff, 0xff, 0xff, 0xff, 0xff, 0xff, 0x07, 0xff, 0xff, 0xff, 0xff, 0xff, 
  0xff, 0xff, 0xff, 0xff, 0xff, 0xff, 0xff, 0xff, 0xff, 0xff, 0x0f, 0xff, 0xff, 0xff, 0xff, 0xff, 
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  0xff, 0xff, 0xff, 0xff, 0xff, 0xff, 0xff, 0xff, 0xff, 0xff, 0xff, 0xff, 0xff, 0xff, 0xff, 0xff
};
// cigar frame 5, 128x54px
const unsigned char cigar_5 [] PROGMEM = {
  0xff, 0xff, 0xff, 0xff, 0xff, 0xff, 0xff, 0xff, 0xfc, 0xff, 0xff, 0xff, 0xff, 0xff, 0xff, 0xff, 
  0xff, 0xff, 0xff, 0xff, 0xff, 0xff, 0xff, 0xff, 0xe0, 0xfc, 0xff, 0xff, 0xff, 0xff, 0xff, 0xff, 
  0xff, 0xff, 0xff, 0xff, 0xff, 0xff, 0xff, 0xff, 0xe0, 0xf8, 0x3f, 0xff, 0xff, 0xff, 0xff, 0xff, 
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  0xff, 0xff, 0xff, 0xff, 0xff, 0xff, 0xff, 0xff, 0xff, 0xff, 0xff, 0xff, 0xff, 0xff, 0xff, 0xff
};

// Array of all bitmaps for convenience. (Total bytes used to store images in PROGMEM = 4400)
const int cigarArray_LEN = 5;
const unsigned char* cigarArray[5] = {
  cigar_1,
  cigar_2,
  cigar_3,
  cigar_4,
  cigar_5
};

/*
  ███████ ███████ ████████ ██    ██ ██████  
  ██      ██         ██    ██    ██ ██   ██ 
  ███████ █████      ██    ██    ██ ██████  
       ██ ██         ██    ██    ██ ██      
  ███████ ███████    ██     ██████  ██                                              
 */
void setup() {
  Serial.begin( 115200);

  display.begin( 0x3C, true);
  display.display();
  delay( 500);

  FastLED.addLeds<NEOPIXEL, LED_PIN>( leds, 1).setCorrection( TypicalSMD5050 );
  FastLED.setBrightness( 20);
  leds[0] = CRGB::Orange;
  FastLED.show();

  // Clear the buffer.
  display.clearDisplay();
  display.display();

  display.setRotation(1);

  pinMode(BUTTON_A_PIN, INPUT_PULLUP);
  pinMode(BUTTON_B_PIN, INPUT_PULLUP);
  pinMode(BUTTON_C_PIN, INPUT_PULLUP);

  display.setTextSize(1);
  display.setTextColor(SH110X_WHITE);
  display.setCursor(0,0);

  // Run diagnostics and display
  display.println("Humidor v001");
  display.display();

  display.println("Adafruit SHT4x test");
  display.display();
  if (! sht4.begin()) {
    display.println("Couldn't find SHT4x");
    display.display();
    while (1) delay(100);
  }
  display.println("Found SHT4x sensor");
  display.print("Serial number 0x");
  display.println(sht4.readSerial(), HEX);
  display.display();
  leds[0] = CRGB::SkyBlue;
  FastLED.show();

  // High precision increases read time.
  // No heater limits heat range (non issue) and is faster.
  sht4.setPrecision(SHT4X_HIGH_PRECISION);
  sht4.setHeater(SHT4X_NO_HEATER);

  temperatureReadings.count = 0;
  humidityReadings.count = 0;

  // Delay before entering loop.
  delay(2000);
}

/*
  ██       ██████   ██████  ██████  
  ██      ██    ██ ██    ██ ██   ██ 
  ██      ██    ██ ██    ██ ██████  
  ██      ██    ██ ██    ██ ██      
  ███████  ██████   ██████  ██      
 */
void loop() {
  sensors_event_t humidity, temp;
  static int activeA = 0;
  static int activeB = 0;
  static int activeC = 0;
  static int counter = 0;

  // Process sensor events.
  sht4.getEvent( &humidity, &temp);

  // Process events into readings.
  // Humidity is stored as relative humidity.
  // Temperature is converted to Farenheit.
  updateHumidityReadings( humidity.relative_humidity);
  updateTemperatureReadings( temp.temperature * 1.8 + 32);

  // Update NeoPixel.
  updateNeopixel();

  // Check buttons to take appropriate action.
  if( !digitalRead( BUTTON_A_PIN) ){
    activeA = 120;
    activeB = 0;
    activeC = 0;
  } else if( !digitalRead( BUTTON_B_PIN) ){
    activeA = 0;
    activeB = 120;
    activeC = 0;
  } else if( !digitalRead( BUTTON_C_PIN) ){
    activeA = 0;
    activeB = 0;
    activeC = 120;
  }
  delay(10);

  display.clearDisplay();
  if( activeA > 0 ){
    displayLastReadings();
    activeA -= 1;
  } else if( activeB > 0){
    displayReadings();
    activeB -= 1;
  } else if( activeC > 0){
    displaySprite();
    activeC -= 1;
  }

  yield();
  display.display();
  delay(490);
}

/*
  ███████ ██    ██ ███    ██  ██████ ████████ ██  ██████  ███    ██ ███████ 
  ██      ██    ██ ████   ██ ██         ██    ██ ██    ██ ████   ██ ██      
  █████   ██    ██ ██ ██  ██ ██         ██    ██ ██    ██ ██ ██  ██ ███████ 
  ██      ██    ██ ██  ██ ██ ██         ██    ██ ██    ██ ██  ██ ██      ██ 
  ██       ██████  ██   ████  ██████    ██    ██  ██████  ██   ████ ███████ 
 */

 void displayLastReadings(){
  display.setTextSize( 2);
  display.setCursor( 0, 1);
  display.println( "Temp: ");
  display.print( " ");
  display.print( temperatureReadings.lastValue);
  display.println( " F");
  
  display.println( "Humidity:");
  display.print( " ");
  display.print( humidityReadings.lastValue);
  display.println( "% rH");
}

void displayReadings(){
  display.setTextSize( 1);
  display.setCursor( 0, 1);
  display.println( "Temp:");
  display.print( " min: ");
  display.print( temperatureReadings.minValue);
  display.println( " F");
  display.print( " avg: ");
  display.print( temperatureReadings.avgValue);
  display.println( " F");
  display.print( " max: ");
  display.print( temperatureReadings.maxValue);
  display.println( " F");
  display.println( "Humidity:");
  display.print( " min: ");
  display.print( humidityReadings.minValue);
  display.println( "% rH");
  display.print( " avg: ");
  display.print( humidityReadings.avgValue);
  display.println( "% rH");
  display.print( " max: ");
  display.print( humidityReadings.maxValue);
  display.println( "% rH");
}

void displaySprite(){
  static int cigarIndex = 0;

  display.setTextSize( 1);
  display.setCursor( 0, 1);
  display.println( "Jon's Humidor ~ 2021");
  display.drawBitmap( 0, 10, cigarArray[cigarIndex], 128, 54, SH110X_WHITE);

  if( cigarIndex == cigarArray_LEN - 1 ){
    cigarIndex = 0;
  } else {
    cigarIndex += 1;
  }

}

void updateNeopixel(){
  static float adjusted;
  static float threshold;

  if ( temperatureReadings.lastValue < 50.0 || temperatureReadings.lastValue > 85.0 ){
    leds[0] = CRGB::Red;
    FastLED.show();
    return;
  }

  adjusted = temperatureReadings.lastValue - 70.0;
  threshold = adjusted < 0 ? abs(adjusted) * 3 + 70 : 70 - adjusted * 2;

  if( humidityReadings.lastValue >= (threshold - 5) && humidityReadings.lastValue <= (threshold + 5)){
    leds[0] = CRGB::Green;
  } else if( humidityReadings.lastValue >= (threshold - 15) && humidityReadings.lastValue <= (threshold + 15)){
    leds[0] = CRGB::Yellow;
  }
  else{
    leds[0] = CRGB::Red;
  }
  FastLED.show();
}

void updateHumidityReadings( float rH){
  humidityReadings.lastValue = rH;

  if( humidityReadings.count == 0 ){
    humidityReadings.maxValue = rH;
    humidityReadings.minValue = rH;
    humidityReadings.avgValue = rH;
  } else {
    if ( rH > humidityReadings.maxValue ){
      humidityReadings.maxValue = rH;
    } else if ( rH < humidityReadings.minValue ){
      humidityReadings.minValue = rH;
    }
    humidityReadings.avgValue = (
      (humidityReadings.avgValue * (humidityReadings.count - 1)) + rH
    ) / humidityReadings.count;
  }

  // Increment count. 1.5 days, reduce the count to 0.5 days.
  humidityReadings.count += 1;
  if( humidityReadings.count > 259200 ){
    humidityReadings.count = 86400;
  }
}

void updateTemperatureReadings( float f){
  temperatureReadings.lastValue = f;

  if( temperatureReadings.count == 0 ){
    temperatureReadings.maxValue = f;
    temperatureReadings.minValue = f;
    temperatureReadings.avgValue = f;
  } else {
    if ( f > temperatureReadings.maxValue ){
      temperatureReadings.maxValue = f;
    } else if ( f < temperatureReadings.minValue ){
      temperatureReadings.minValue = f;
    }
    temperatureReadings.avgValue = (
      (temperatureReadings.avgValue * (temperatureReadings.count - 1)) + f
    ) / temperatureReadings.count;
  }

  // Increment count. 1.5 days, reduce the count to 0.5 days.
  temperatureReadings.count += 1;
  if( temperatureReadings.count > 259200 ){
    temperatureReadings.count = 86400;
  }
}